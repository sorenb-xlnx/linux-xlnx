## Documentation/devicetree/bindings/clock/clk-userspace.txt
```
Example:
	usclk: usclk {
		compatible = "clk-userspace";
		clocks = <&foo 15>, <&bar>;
		clock-count = <2>;
	};
```

## Documentation/devicetree/bindings/media/i2c/imx274.txt
```
* Sony 1/2.5-Inch 8.51Mp CMOS Digital Image Sensor

The Sony imx274 is a 1/2.5-inch CMOS active pixel digital image sensor with
an active array size of 3864H x 2202V. It is programmable through a simple
two-wire serial interface.

Required Properties:
- compatible: value should be "Sony,imx274" for imx274 sensor

Optional Properties:
- sensor_reset-gpios: Sensor reset GPIO

For further reading on port node refer to
Documentation/devicetree/bindings/media/video-interfaces.txt.

Example:

&axi_iic_0_sensor {
	imx274: sensor@1a{
		compatible = "sony,imx274";
		reg = <0x1a>;
		#address-cells = <1>;
		#size-cells = <0>;

		reset-gpios = <&gpio_sensor 0 1>;

		port@0 {
			reg = <0>;
			sensor_out: endpoint {
				remote-endpoint = <&csiss_in>;
			};
		};
	};
```
